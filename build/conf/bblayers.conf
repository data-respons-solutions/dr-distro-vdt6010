## build/conf/bblayers.conf
```bitbake
# LAYER_CONF_VERSION is increased each time build/conf/bblayers.conf
# changes incompatibly
LCONF_VERSION = "7"

BBPATH = "${TOPDIR}"
BBFILES ?= ""

BBLAYERS ?= " \
  /opt/oe/dr-vdt6010-distro/oe-core/meta \
  /opt/oe/dr-vdt6010-distro/oe-core/../meta-openembedded/meta-oe \
  /opt/oe/dr-vdt6010-distro/oe-core/../meta-openembedded/meta-networking \
  /opt/oe/dr-vdt6010-distro/oe-core/../meta-openembedded/meta-python \
  /opt/oe/dr-vdt6010-distro/oe-core/../meta-freescale \
  /opt/oe/dr-vdt6010-distro/oe-core/../meta-bsp-vdt6010 \
  /opt/oe/dr-vdt6010-distro/oe-core/../meta-datarespons \
  /opt/oe/dr-vdt6010-distro/oe-core/../meta-factory \
  "
```

## meta-vdt6010/conf/layer.conf
```bitbake
# We have a conf and classes directory, add to BBPATH
BBPATH .= ":${LAYERDIR}"

# We have a packages directory, add to BBFILES
BBFILES += "${LAYERDIR}/recipes-*/*/*.bb \
            ${LAYERDIR}/recipes-*/*/*.bbappend"

BBFILE_COLLECTIONS += "vdt6010-layer"
BBFILE_PATTERN_vdt6010-layer := "^${LAYERDIR}/"
BBFILE_PRIORITY_vdt6010-layer = "6"

LAYERDEPENDS_vdt6010-layer = "core freescale-layer bsp-common-layer bsp-vdt6010-layer browser-layer"
LAYERSERIES_COMPAT_vdt6010-layer = "dunfell"

# Let us add layer-specific bbappends which are only applied when that
# layer is included in our configuration
BBFILES += "${@' '.join('${LAYERDIR}/%s/recipes*/*/*.bbappend' % layer \
               for layer in BBFILE_COLLECTIONS.split())}"
               
```
